## LuaNode_Esp32/LuaNode32/components/server/Kconfig
```kconfig
menu "SERVER"

config UART_ENABLE
    bool "Enable server"
    default "y"
    help
        For server.

endmenu
```

## LuaNode_Esp32/LuaNode32/components/spiffs/Kconfig
```kconfig
menu "SPIFFS"

config SPIFFS_ENABLE
    bool "Enable spiffs"
    default "y"
    help
        For spiffs.

endmenu
```
